## Kconfig
```kconfig
config ZMK_BEHAVIOR_FORCE_UPPER
    bool
    default y
    depends on DT_HAS_ZMK_BEHAVIOR_FORCE_UPPER_ENABLED
    depends on ZMK_HID_INDICATORS

config ZMK_BEHAVIOR_FORCE_LOWER
    bool
    default y
    depends on DT_HAS_ZMK_BEHAVIOR_FORCE_LOWER_ENABLED
    depends on ZMK_HID_INDICATORS
```

## dts/bindings/behaviors/zmk,behavior-force-true-lower.yaml
```yaml
# Copyright (c) 2025 The ZMK Contributors
# SPDX-License-Identifier: MIT

description: Force True Lowercase Behavior (ignores CapsLock and Shift)

compatible: "zmk,behavior-force-true-lower"

include: one_param.yaml
```

## dts/bindings/behaviors/zmk,behavior-force-true-upper.yaml
```yaml
# Copyright (c) 2025 The ZMK Contributors
# SPDX-License-Identifier: MIT

description: Force True Uppercase Behavior (ignores CapsLock and Shift)

compatible: "zmk,behavior-force-true-upper"

include: one_param.yaml
```
