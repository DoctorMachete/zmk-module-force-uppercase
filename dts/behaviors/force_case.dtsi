/*
 * Copyright (c) 2025 The ZMK Contributors
 *
 * SPDX-License-Identifier: MIT
 */

/ {
    behaviors {
        /omit-if-no-ref/ fucase: force_upper {
            compatible = "zmk,behavior-force-upper";
            #binding-cells = <1>;
        };

        /omit-if-no-ref/ flcase: force_lower {
            compatible = "zmk,behavior-force-lower";
            #binding-cells = <1>;
        };
    };
};
